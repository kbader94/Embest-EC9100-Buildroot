## embest_br_ext/Config.in
```kconfig
menu "External Options"
    source "../embest_br_ext/package/fc-tests/Config.in"
endmenu
```

## embest_br_ext/configs/embest_ec9100_defconfig
```kconfig
# ---- CPU/ABI (i.MX6UL, Cortex-A7)----
BR2_arm=y
BR2_cortex_a7=y
BR2_ARM_EABIHF=y
BR2_ARM_FPU_NEON_VFPV4=y

# ---- Toolchain ----
BR2_TOOLCHAIN_BUILDROOT=y
BR2_TOOLCHAIN_BUILDROOT_GLIBC=y

# ---- Kernel ----
BR2_LINUX_KERNEL=y
BR2_KERNEL_HEADERS_AS_KERNEL=y
BR2_LINUX_KERNEL_CUSTOM_GIT=y
BR2_LINUX_KERNEL_CUSTOM_REPO_URL="https://github.com/kbader94/linux.git"
BR2_PACKAGE_HOST_LINUX_HEADERS_CUSTOM_6_17=y
BR2_LINUX_KERNEL_CUSTOM_REPO_VERSION="FC_imx6"
BR2_LINUX_KERNEL_USE_DEFCONFIG=y
BR2_LINUX_KERNEL_DEFCONFIG="imx_v6_v7"
BR2_LINUX_KERNEL_DTS_SUPPORT=y
BR2_LINUX_KERNEL_INTREE_DTS_NAME="nxp/imx/imx6ul-embest-ec9100"
BR2_LINUX_KERNEL_NEEDS_HOST_OPENSSL=y

# ---- Basic rootfs + post-image for i.MX images if you want it later ----
BR2_TARGET_ROOTFS_EXT2=y
BR2_TARGET_ROOTFS_EXT2_4=y
BR2_ROOTFS_POST_IMAGE_SCRIPT="$(BR2_EXTERNAL)/board/embest/ec9100/post-image.sh"


# ---- Console on UART3 (ttymxc2) ----
BR2_TARGET_GENERIC_GETTY=y
BR2_TARGET_GENERIC_GETTY_PORT="ttymxc2"
BR2_TARGET_GENERIC_GETTY_BAUDRATE_KEEP=y

# ---- U-Boot
BR2_TARGET_UBOOT=y
BR2_TARGET_UBOOT_BOARDNAME="embest_ec9100"
BR2_TARGET_UBOOT_CUSTOM_GIT=y
BR2_TARGET_UBOOT_CUSTOM_REPO_URL="https://github.com/kbader94/uboot-imx.git"
BR2_TARGET_UBOOT_CUSTOM_REPO_VERSION="lf_v2025.04"
BR2_TARGET_UBOOT_NEEDS_DTC=y
BR2_TARGET_UBOOT_NEEDS_OPENSSL=y

# U-Boot output formats for i.MX6UL
BR2_TARGET_UBOOT_FORMAT_BIN=y
BR2_TARGET_UBOOT_FORMAT_IMG=y
BR2_TARGET_UBOOT_FORMAT_IMX=y
# BR2_TARGET_UBOOT_SPL=y
# BR2_TARGET_UBOOT_SPL_NAME="SPL"

# ---- host utils for SD image creation ----
BR2_PACKAGE_HOST_DOSFSTOOLS=y
BR2_PACKAGE_HOST_GENIMAGE=y
BR2_PACKAGE_HOST_MTOOLS=y
BR2_PACKAGE_HOST_UBOOT_TOOLS=y

# FC TESTS package and kernel config
BR2_PACKAGE_FC_TESTS=y
BR2_LINUX_KERNEL_CONFIG_FRAGMENT_FILES="/media/kyle/extra_storage/Large-Projects/Embest-EC9100-Buildroot/embest_br_ext/board/embest/ec9100/linux-fragments/fc-tests.cfg"
```

## embest_br_ext/package/fc-tests/Config.in
```kconfig
config BR2_PACKAGE_FC_TESTS
    bool "fc_tests (FIFO Control tests)"
    depends on BR2_LINUX_KERNEL  
    help
      FIFO Control test suite (fc_tests).
      Installs kernel modules and the rtt_tests user binary.
```
